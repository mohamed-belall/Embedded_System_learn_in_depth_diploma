VERSION ""

NS_ :

BS_:

BU_: ECU2_speedSensor ECU1_ACC_CMD

BO_ 939 speedVal_message: 1 ECU2_speedSensor
 SG_ Speed : 0|8@1+ (1,0) [0|255] ""  ECU1_ACC_CMD

BO_ 48 ACC_CMD_message: 1 ECU1_ACC_CMD
 SG_ ACC_ON : 0|8@1+ (1,0) [0|1] ""  ECU2_speedSensor
